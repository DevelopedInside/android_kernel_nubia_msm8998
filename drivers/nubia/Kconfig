## drivers/nubia/Kconfig
```kconfig
#
# Nubia drivers configuration
#

#menuconfig NUBIA_DRIVERS
menu "nubia drivers"

config NUBIA_DRIVERS
	bool "NUBIA DRIVERS"
	default n
	help
	  Say Y here if you want to enable NUBIA DRIVERS
	  If unsure, say N.

comment "Nubia Device Drivers"

# Add nubia drivers configuration here

config NUBIA_TOUCHSCREENS
	bool "NUBIA_TOUCHSCREENS"
	depends on NUBIA_DRIVERS
	default n
	help
	  Say Y here if you want to enable NUBIA_TOUCHSCREENS
	  If unsure, say N.

source "drivers/nubia/touch/Kconfig"

endmenu

# Nubia configuration options

config MACH_NUBIA
    bool "NUBIA device"
    depends on ARCH_QCOM
    help
      Support for Nubia products

config MACH_NUBIA_MSM8998
    bool "NUBIA MSM8998"
    depends on ARCH_MSM8998
    select MACH_NUBIA
    help
      Support for MSM8998 Nubia variants

menu "Nubia board selection"

config MACH_NUBIA_NX563J
    bool "NUBIA_NX563J board"
    select MACH_NUBIA_MSM8998
    help
      Support for Nubia Z17 variant

config MACH_NUBIA_NX595J
    bool "NUBIA_NX595J board"
    select MACH_NUBIA_MSM8998
    help
      Support for Nubia Z17S variant

config MACH_NUBIA_NX609J
    bool "NUBIA_NX609J board"
    select MACH_NUBIA_MSM8998
    help
      Support for Nubia Red Magic variant

endmenu
```

## drivers/nubia/touch/Kconfig
```kconfig
menu "nubia driver touchscreens"

config NUBIA_SYNAPTICS_DSX
        bool "config nubia synaptics dsx"
        default n
        help
          Say Y here if you have a nubia touchscreen hxchipset connected
          to your system.
	  If unsure, say N.

source "drivers/nubia/touch/nubia_synaptics_dsx/Kconfig"

endmenu
```

## drivers/power/supply/qcom/Kconfig
```kconfig
menu "Qualcomm Technologies Inc Charger and Fuel Gauge support"

config QPNP_SMBCHARGER
	tristate "QPNP SMB Charger driver"
	depends on MFD_SPMI_PMIC
	help
	  Say Y here to enable the dual path switch mode battery charger which
	  supports USB detection and battery charging up to 3A.
	  The driver also offers relevant information to userspace via the
	  power supply framework.

config QPNP_FG
	tristate "QPNP fuel gauge driver"
	depends on MFD_SPMI_PMIC
	help
	  Say Y here to enable the Fuel Gauge driver. This adds support for
	  battery fuel gauging and state of charge of battery connected to the
	  fuel gauge. The state of charge is reported through a BMS power
	  supply property and also sends uevents when the capacity is updated.

config QPNP_FG_GEN3
	tristate "QPNP GEN3 fuel gauge driver"
	depends on MFD_SPMI_PMIC
	help
	  Say Y here to enable the GEN3 Fuel Gauge driver. This adds support
	  for battery fuel gauging and state of charge of battery connected to
	  the fuel gauge. The state of charge is reported through a BMS power
	  supply property and also sends uevents when the capacity is updated.

config SMB135X_CHARGER
	tristate "SMB135X Battery Charger"
	depends on I2C
	help
	  Say Y to include support for SMB135X Battery Charger.
	  SMB135X is a dual path switching mode charger capable of charging
	  the battery with 3Amps of current.
	  The driver supports charger enable/disable.
	  The driver reports the charger status via the power supply framework.
	  A charger status change triggers an IRQ via the device STAT pin.

config SMB1351_USB_CHARGER
	tristate "smb1351 usb charger (with VBUS detection)"
	depends on I2C
	help
	 Say Y to enable support for the SMB1351 switching mode based charger.
	 The driver supports charging control (enable/disable) and
	 charge-current limiting. It also provides USB VBUS detection and
	 notification support. The driver controls SMB1351 via I2C and
	 supports device-tree interface.

config MSM_BCL_CTL
	bool "BCL Framework driver"
	help
	  Say Y here to enable this BCL Framework driver. This driver provides
	  interface, which can be used by the BCL h/w drivers to implement the
	  basic functionalities. This framework abstracts the underlying
	  hardware for the top level modules.

config MSM_BCL_PERIPHERAL_CTL
	bool "BCL driver to control the PMIC BCL peripheral"
	depends on SPMI
	depends on MSM_BCL_CTL
	help
	  Say Y here to enable this BCL PMIC peripheral driver. This driver
	  provides routines to configure and monitor the BCL
	  PMIC peripheral.

config BATTERY_BCL
	tristate "Battery Current Limit driver"
	depends on THERMAL_MONITOR
	help
	  Say Y here to enable support for battery current limit
	  device. The BCL driver will poll BMS if
	  thermal daemon enables BCL.
	  It will notify thermal daemon if IBat crosses Imax threshold.

config QPNP_SMB2
	tristate "SMB2 Battery Charger"
	depends on MFD_SPMI_PMIC
	help
	  Enables support for the SMB2 charging peripheral

config SMB138X_CHARGER
	tristate "SMB138X Battery Charger"
	depends on MFD_I2C_PMIC
	help
	  Say Y to include support for SMB138X Battery Charger.
	  SMB1380 is a dual phase 6A battery charger, and SMB1381 is a single
	  phase 5A battery charger.
	  The driver supports charger enable/disable.
	  The driver reports the charger status via the power supply framework.
	  A charger status change triggers an IRQ via the device STAT pin.

config QPNP_QNOVO
	bool "QPNP QNOVO driver"
	depends on MFD_SPMI_PMIC
	help
	  Say Y here to enable the Qnovo pulse charging engine. Qnovo driver
	  accepts pulse parameters via sysfs entries and programs the hardware
	  module. It also allows userspace code to read diagnostics of voltage
	  and current measured during certain phases of the pulses.

config TYPEC_AUDIO_ADAPTER_SWITCH
	bool "Type C audio apapter switch"
	depends on SPMI
	help
	  Say Y here to enable typec audio adpater switch controller.

config NUBIA_CHARGE_FEATURE
	bool "nubia charge feature support"
	depends on SPMI
	help
	  Say Y here to enable nubia charge feature support.

config NUBIA_HW_STEP_CHARGE_FEATURE
	bool "Qualcomm hw step charge feature support"
	depends on SPMI
	help
	  Say Y here to enable Qualcomm hw step charge feature support.

config NEO_DIRECT_CHARGE_SUPPORT
	bool "neo direct charge feature support"
	depends on MFD_SPMI_PMIC
	help
	  Say Y here to enable neo direct charge feature support.

config NEO_WP502X_CHARGER
	bool "wp502x charger feature support"
	depends on NEO_DIRECT_CHARGE_SUPPORT
	help
	  Say Y here to enable wp502x charger feature support.

config DIRECT_QC_COMPATIBLE_FEATURE
	bool "compatible for direct and quick charger feature support"
	depends on MFD_SPMI_PMIC
	help
	  Say Y here to enable wp502x charger feature support.

config NEO_BQ27520_BATTERY
	tristate "BQ27520 battery driver"
	depends on I2C
	help
	  Say Y here to enable support for batteries with BQ27520 (I2C/HDQ) chips.

config NEO_EXTERNAL_FG_SUPPORT
	tristate "external fuel gauge support driver"
	help
	  Say Y here to enable support for batteries with BQ27520 (I2C/HDQ) chips.
endmenu
```

## drivers/power/ztemt_power_debug/Kconfig
```kconfig
config ZTEMT_POWER_DEBUG
	bool "ZTEMT Power Debug Feature"
	default y
	help
	  ZTEMT Power Debug Feature
```
