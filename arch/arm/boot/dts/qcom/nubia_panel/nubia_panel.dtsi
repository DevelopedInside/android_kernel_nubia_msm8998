#include "nubia-dsi-panel-jdi-r63452-1080p-5p5-cmd.dtsi"
#include "nubia-dsi-panel-jdi-r63452-1080p-5p5-video.dtsi"
#include "nubia-dsi-panel-sharp-r63417-1080p-5p5-cmd.dtsi"
#include "nubia-dsi-panel-sharp-r63417-1080p-5p5-video.dtsi"
#include "nubia-jdi-td4310-1080-2160-5p99-video.dtsi"
