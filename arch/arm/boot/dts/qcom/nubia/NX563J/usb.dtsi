/*
 * nubia overrides dts
 */

&qusb_phy0 {
	reg = <0x0c012000 0x2a8>,
	      <0x01fcb24c 0x4>,
	      <0x00784238 0x4>;
	reg-names = "qusb_phy_base",
			"tcsr_clamp_dig_n_1p8",
			"efuse_addr";
	qcom,efuse-bit-pos = <16>;
	qcom,efuse-num-bits = <4>;
	qcom,qusb-phy-init-seq =
			/* <value reg_offset> */
				<0x13 0x04 /* analog_controls_two */
				0x7c 0x18c /* pll_clock_inverter */
				0x80 0x2c /* pll_cmode */
				0x0a 0x184 /* pll_lock_delay */
				0xf0 0x23c /* tune1 */
				0x08 0x240 /* tune2 */
				0x04 0x248 /* tune4 */
				0x19 0xb4>; /* digital_timers_two */
};
&usb3 {
	dwc3@a800000 {
		maximum-speed = "high-speed";
	};
};

