/*
 * Copyright (c) 2015-2016, The Linux Foundation. All rights reserved.
 *
 * This program is free software; you can redistribute it and/or modify
 * it under the terms of the GNU General Public License version 2 and
 * only version 2 as published by the Free Software Foundation.
 *
 * This program is distributed in the hope that it will be useful,
 * but WITHOUT ANY WARRANTY; without even the implied warranty of
 * MERCHANTABILITY or FITNESS FOR A PARTICULAR PURPOSE.  See the
 * GNU General Public License for more details.
 */

&i2c_5 {
	status = "okay";
	synaptics_dsx@20 {
	status = "okay";
	compatible = "synaptics,dsx-i2c";
	reg = <0x4b>;
	interrupt-parent = <&tlmm>;
	interrupts = <125 0x2008>;
	//vdd_ana-supply = <&pm8998_l22>;
	//vcc_i2c-supply = <&pm8998_l14>;
	//synaptics,pwr-reg-name = "vdd_ana";
	synaptics,bus-reg-name = "vcc_i2c";
	synaptics,irq-gpio = <&tlmm 125 0x2008>;
	synaptics,irq-on-state = <0>;
	synaptics,irq-flags = <0x2008>;  //IRQF_ONESHOT | IRQF_TRIGGER_LOW
	synaptics,power-delay-ms = <20>;
	synaptics,ub-i2c-addr = <0x2c>;
	synaptics,reset-delay-ms = <100>;
	synaptics,firmware-image-name = "nubia_tp_jdi_fw.img";
	pinctrl-names = "synaptics_pin_active", "synaptics_pin_suspend";
	pinctrl-0 = <&synaptics_int_active>;
	pinctrl-1 = <&synaptics_int_suspend>;
	synaptics,full_raw_limit_lower = <
	1815 1773 1734 1719 1748 1730 1731 1754 1705 1698 1731 1686 1693 1728 1691 1687 1713 1682 1686 1709 1677 1680 1727 1695 1710 1714 1704 1706 1739 1694 1714 1783
	1651 1641 1610 1604 1634 1614 1629 1663 1625 1631 1692 1633 1650 1681 1647 1654 1685 1650 1659 1688 1653 1657 1693 1662 1681 1695 1679 1689 1721 1676 1693 1760
	1652 1642 1615 1612 1644 1621 1639 1670 1634 1638 1684 1642 1652 1688 1657 1665 1697 1662 1671 1700 1665 1670 1707 1675 1695 1711 1694 1704 1735 1687 1705 1772
	1654 1642 1617 1616 1649 1627 1645 1678 1638 1644 1691 1645 1657 1702 1661 1671 1709 1668 1680 1713 1673 1680 1725 1683 1708 1726 1702 1715 1754 1693 1728 1790
	1663 1655 1618 1624 1657 1630 1655 1681 1642 1654 1691 1647 1664 1701 1664 1679 1714 1674 1691 1715 1681 1692 1730 1690 1718 1731 1709 1724 1758 1699 1733 1794
	1661 1647 1616 1623 1652 1631 1656 1684 1642 1652 1694 1646 1663 1701 1663 1679 1715 1674 1693 1718 1683 1695 1733 1692 1720 1733 1709 1724 1757 1698 1732 1793
	1657 1644 1614 1622 1652 1631 1656 1685 1642 1653 1693 1645 1662 1700 1662 1680 1715 1675 1694 1718 1683 1697 1734 1693 1722 1734 1709 1725 1758 1699 1734 1796
	1653 1640 1610 1619 1649 1628 1654 1682 1639 1650 1690 1642 1659 1697 1659 1676 1713 1673 1692 1719 1681 1695 1736 1691 1719 1735 1705 1724 1771 1695 1719 1762
	1642 1607 1608 1603 1647 1627 1647 1684 1639 1644 1689 1642 1651 1697 1659 1670 1712 1673 1687 1722 1681 1690 1733 1691 1712 1729 1705 1710 1747 1694 1711 1783
	1625 1605 1636 1589 1614 1648 1626 1623 1668 1625 1639 1685 1647 1653 1694 1657 1667 1695 1663 1665 1710 1673 1684 1725 1687 1695 1725 1683 1683 1693 1698 1722
	1612 1619 1659 1586 1630 1655 1624 1626 1670 1624 1646 1683 1645 1660 1693 1656 1674 1696 1662 1672 1704 1671 1692 1724 1686 1703 1728 1683 1700 1723 1698 1735
	1610 1624 1645 1585 1626 1647 1624 1626 1667 1625 1647 1680 1648 1661 1695 1658 1675 1697 1663 1673 1705 1672 1693 1726 1689 1705 1730 1686 1700 1725 1699 1733
	1609 1622 1644 1584 1623 1646 1623 1624 1666 1625 1647 1681 1649 1662 1696 1658 1674 1696 1662 1671 1704 1671 1691 1724 1687 1703 1729 1685 1699 1723 1697 1729
	1607 1621 1643 1584 1621 1645 1623 1624 1666 1626 1648 1683 1651 1663 1697 1659 1673 1695 1660 1668 1701 1668 1689 1718 1686 1703 1727 1684 1699 1725 1695 1724
	1603 1614 1645 1582 1617 1646 1620 1619 1666 1625 1642 1685 1650 1657 1696 1657 1664 1690 1654 1658 1700 1662 1676 1715 1680 1692 1719 1680 1687 1712 1690 1713
	1600 1603 1632 1581 1611 1636 1618 1612 1658 1623 1639 1678 1649 1655 1688 1655 1659 1676 1649 1650 1686 1656 1668 1704 1674 1684 1710 1675 1682 1707 1686 1709
	1597 1600 1629 1578 1606 1631 1613 1607 1652 1618 1634 1673 1644 1648 1681 1648 1650 1667 1639 1647 1693 1646 1658 1692 1662 1672 1703 1665 1672 1695 1678 1700
	1637 1630 1660 1607 1634 1659 1641 1634 1678 1646 1662 1700 1670 1676 1711 1675 1678 1709 1680 1685 1723 1703 1714 1756 1740 1760 1803 1772 1779 1808 1806 1853
	>;
	synaptics,full_raw_limit_upper = <
	3370 3293 3219 3192 3245 3213 3215 3258 3167 3154 3214 3131 3143 3208 3141 3133 3182 3124 3130 3173 3115 3120 3207 3149 3176 3182 3164 3168 3230 3146 3182 3311
	3066 3048 2991 2979 3034 2998 3025 3088 3019 3028 3142 3032 3065 3121 3059 3072 3130 3065 3080 3134 3070 3078 3144 3086 3122 3148 3118 3137 3196 3112 3144 3268
	3068 3049 3000 2993 3052 3011 3043 3101 3035 3041 3127 3049 3068 3136 3077 3092 3152 3086 3103 3158 3093 3102 3171 3110 3148 3177 3145 3164 3221 3134 3167 3292
	3072 3050 3003 3000 3063 3021 3055 3115 3042 3053 3141 3055 3076 3160 3084 3103 3174 3098 3119 3181 3107 3120 3204 3125 3172 3205 3161 3186 3258 3144 3209 3323
	3088 3074 3004 3017 3078 3028 3074 3122 3050 3071 3141 3059 3090 3160 3090 3118 3184 3109 3141 3186 3121 3143 3214 3139 3191 3215 3173 3201 3264 3155 3218 3331
	3085 3059 3001 3015 3069 3028 3075 3128 3050 3068 3146 3057 3088 3159 3089 3119 3184 3109 3145 3190 3125 3148 3219 3142 3195 3218 3173 3201 3263 3154 3217 3331
	3077 3054 2998 3013 3068 3028 3075 3129 3050 3069 3144 3056 3087 3158 3087 3119 3185 3110 3146 3191 3126 3151 3221 3145 3199 3220 3174 3204 3265 3155 3221 3335
	3070 3045 2991 3007 3063 3024 3072 3124 3044 3065 3139 3049 3082 3151 3081 3113 3181 3106 3143 3193 3122 3147 3224 3140 3193 3221 3166 3202 3289 3148 3193 3271
	3049 2985 2987 2976 3058 3022 3059 3128 3044 3053 3137 3049 3067 3152 3081 3102 3180 3107 3134 3197 3123 3138 3219 3141 3180 3211 3166 3176 3244 3146 3177 3311
	3018 2981 3039 2951 2997 3060 3020 3014 3097 3017 3044 3129 3058 3070 3146 3078 3097 3148 3089 3093 3175 3106 3128 3204 3133 3148 3204 3126 3126 3143 3154 3197
	2993 3007 3080 2945 3026 3073 3016 3019 3102 3016 3056 3125 3055 3082 3145 3076 3109 3150 3087 3106 3165 3104 3142 3202 3132 3163 3209 3126 3156 3201 3154 3221
	2991 3016 3056 2944 3019 3059 3016 3020 3095 3018 3059 3121 3060 3086 3148 3080 3110 3151 3088 3107 3167 3105 3144 3206 3136 3166 3213 3131 3158 3203 3155 3218
	2989 3012 3054 2941 3015 3057 3014 3017 3094 3019 3059 3122 3062 3087 3149 3080 3108 3150 3086 3103 3164 3103 3140 3202 3134 3164 3211 3129 3156 3201 3152 3211
	2984 3010 3052 2941 3011 3055 3014 3016 3095 3021 3061 3125 3066 3088 3152 3082 3107 3148 3083 3099 3159 3098 3137 3191 3130 3163 3208 3128 3154 3204 3148 3202
	2978 2998 3055 2938 3002 3057 3009 3007 3094 3017 3049 3130 3064 3077 3150 3078 3091 3139 3072 3079 3156 3087 3113 3185 3121 3142 3192 3121 3134 3179 3139 3182
	2971 2976 3031 2935 2991 3038 3005 2994 3078 3015 3044 3117 3063 3073 3135 3073 3081 3113 3062 3064 3132 3076 3097 3164 3108 3128 3177 3111 3124 3170 3130 3174
	2966 2972 3026 2931 2982 3029 2996 2985 3069 3004 3034 3107 3052 3061 3123 3060 3065 3096 3044 3059 3144 3057 3080 3143 3087 3105 3162 3093 3104 3148 3117 3157
	3040 3028 3083 2984 3035 3081 3048 3035 3116 3057 3086 3158 3102 3112 3178 3111 3117 3173 3121 3130 3200 3162 3183 3261 3232 3268 3349 3291 3304 3358 3354 3442
	>;
	};

};
